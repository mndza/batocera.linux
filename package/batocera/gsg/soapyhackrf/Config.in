## package/batocera/gsg/soapyhackrf/Config.in
```kconfig
config BR2_PACKAGE_SOAPYHACKRF
    bool "soapyhackrf"
    select BR2_PACKAGE_SOAPYSDR
    select BR2_PACKAGE_HACKRF
    help
        Soapy SDR module for HackRF
```

## package/batocera/gsg/soapysdr/Config.in
```kconfig
config BR2_PACKAGE_SOAPYSDR
    bool "soapysdr"
    help
        "A fresh and clean vendor neutral and platform independent SDR support library"

        https://github.com/pothosware/SoapySDR
```

## package/batocera/gsg/waterfall-demo/Config.in
```kconfig
config BR2_PACKAGE_WATERFALL_DEMO
	bool "waterfall-demo"
	depends on BR2_PACKAGE_HOST_RUSTC_TARGET_ARCH_SUPPORTS
	select BR2_PACKAGE_HOST_RUSTC
	help
		Simple waterfall demo using Rust / OpenGL
```
